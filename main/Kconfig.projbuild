## main/Kconfig.projbuild
```kconfig
menu "ESP32_TSDZ Configuration"
    config BT_PIN
        int "BT pairing PIN (6 digits)"
        range 0 999999
        default 123456
        help
            Enter the BT pairing PIN (6 digit)
endmenu
```
